## main/Kconfig.projbuild
```kconfig
menu "Aqua-HMET Hardware Configuration"

    menu "TFT Display — ILI9341 on SPI2_HOST (HSPI)"
        comment "Pins confirmed from physical board header labels (2026-07-01)."
        comment "RST tied to ESP32 EN (software reset via SPI cmd 0x01 — no GPIO needed)."
        comment "MISO not connected (write-only panel). Backlight hardwired to 3V3 (always on)."

        config UBIOPOT_TFT_SCLK
            int "TFT SCLK GPIO"
            default 15
            help
                SPI clock for ILI9341. GPIO15 (HSPI CLK). Strapping pin MTDO — must be HIGH at
                boot (internal pull-up ensures this; no external pull needed).

        config UBIOPOT_TFT_MOSI
            int "TFT MOSI GPIO"
            default 2
            help
                SPI MOSI for ILI9341. GPIO2. Strapping pin — must be LOW/floating at boot
                (internal pull-down). Also doubles as the onboard blue LED on DevKit boards
                (flickers during SPI writes — cosmetic only, not a fault).

        config UBIOPOT_TFT_CS
            int "TFT Chip Select GPIO"
            default 5
            help
                SPI CS for ILI9341. GPIO5. Strapping pin — must be HIGH at boot (idles HIGH
                as a CS line, so no bodge needed). Emits a PWM-like glitch at boot — harmless
                for the display since it's deselected during init.

        config UBIOPOT_TFT_DC
            int "TFT Data/Command GPIO"
            default 4
            help
                Data/Command select for ILI9341. GPIO4.

        config UBIOPOT_TFT_PCLK_HZ
            int "TFT SPI pixel clock (Hz)"
            default 40000000
            help
                40 MHz is safe for ILI9341 on short PCB traces. Reduce to 20000000 if
                display corruption appears on the bench.
    endmenu

    menu "MCP4921 DAC — SPI3_HOST (VSPI)"
        comment "12-bit SPI DAC. SPI word: 0x3000 | (code & 0x0FFF) [BUF=0, GA=1x, SHDN=active]."

        config UBIOPOT_DAC_SCK
            int "DAC SCK GPIO"
            default 18

        config UBIOPOT_DAC_MOSI
            int "DAC MOSI GPIO"
            default 23

        config UBIOPOT_DAC_CS
            int "DAC CS GPIO"
            default 26
    endmenu

    menu "ADS1115 ADC — I2C"
        comment "16-bit ADC. ADDR pin tied to GND => address 0x48. GAIN_ONE (±4.096 V, 0.125 mV/bit)."
        comment "AIN0 = VOUT_UC (cell voltage), AIN1 = IOUT_UC (current, continuous hot-path)."

        config UBIOPOT_ADC_SDA
            int "ADS1115 SDA GPIO"
            default 21

        config UBIOPOT_ADC_SCL
            int "ADS1115 SCL GPIO"
            default 22

        config UBIOPOT_ADC_I2C_FREQ_HZ
            int "I2C frequency (Hz)"
            default 400000
            help
                400 kHz (Fast Mode). ADS1115 supports up to 400 kHz.
    endmenu

    menu "CD4066 Electrode Multiplexer"
        comment "One pin HIGH at a time. All three LOW = all electrodes disconnected."

        config UBIOPOT_MUX_T1
            int "Electrode 1 GPIO (T1)"
            default 32

        config UBIOPOT_MUX_T2
            int "Electrode 2 GPIO (T2)"
            default 25

        config UBIOPOT_MUX_T3
            int "Electrode 3 GPIO (T3)"
            default 33
    endmenu

    menu "Buttons"
        config UBIOPOT_BTN_START
            int "Start/Select Button GPIO"
            default 14
            help
                Primary button (GPIO14). Active-low, INPUT_PULLUP.
                Short press = select/confirm/start. Long press (during scan) = abort.

        config UBIOPOT_BTN_NAV
            int "Nav/Back/Factory-Reset Button GPIO"
            default 0
            help
                Secondary button (GPIO0). Active-low.
                Short press = navigate / cycle focus (LVGL encoder rotate+1).
                Long hold (>=10 s) = factory-reset WiFi credentials (NVS erase).
                STRAPPING PIN (BOOT): must be HIGH at power-on. Do NOT hold this button
                during reset or boot — it will enter flash-download mode.
    endmenu

    menu "Status LEDs"
        config UBIOPOT_LED_READY
            int "Ready LED GPIO"
            default 12
            help
                ON = device idle, ready for measurement.
                STRAPPING PIN (GPIO12 / MTDI / VDD_SDIO): sampled at reset to set flash
                voltage. Must NOT be driven HIGH at the moment of reset. The LED-to-GND
                wiring idles LOW so normal operation is safe — just avoid driving it
                HIGH in app_main before any reset or watchdog trigger.

        config UBIOPOT_LED_PROCESSING
            int "Processing LED GPIO"
            default 13
            help
                ON = measurement in progress.
    endmenu

    menu "WiFi Defaults"
        comment "Overridable at runtime via NVS. Credentials are stored in NVS — never in source."

        config UBIOPOT_WIFI_AP_SSID_PREFIX
            string "SoftAP SSID prefix"
            default "Aqua-HMET"
            help
                Device appends last 4 hex digits of MAC. Example: Aqua-HMET-A1B2.
                This SSID is shown on the TFT QR code and Settings screen.

        config UBIOPOT_WIFI_AP_PASSWORD
            string "SoftAP default password"
            default "aquahmet123"
            help
                Default WPA2 password. Override via POST /api/wifi or NVS.
                Embedded in the WiFi-join QR code shown on the TFT.

        config UBIOPOT_WIFI_AP_MAX_CONN
            int "SoftAP maximum simultaneous clients"
            default 4

        config UBIOPOT_MDNS_HOSTNAME
            string "mDNS hostname"
            default "aquahmet"
            help
                Device is reachable as <hostname>.local when in STA mode.
                Example: aquahmet.local (requires mDNS-compatible network).
    endmenu

    menu "Serial Protocol"
        config UBIOPOT_SERIAL_BAUD
            int "UART0 baud rate (bps)"
            default 115200
            help
                115200 is the default (matches ESP32 ROM bootloader baud; universal
                CP2102/CH340 compatibility). Power users may increase to 230400 or
                460800 for future high-rate techniques.
    endmenu

    menu "Development / Debug"
        config UBIOPOT_SELFTEST_MODE
            bool "Run HAL self-test at boot (P1 bringup mode)"
            default n
            help
                When enabled, app_main runs pstat_hal_selftest() immediately after
                initialising all HAL subsystems, then halts.
                Bringup sequence: DAC ramp, ADC reads, mux cycle, LED blink,
                button wait (10 s). Disable for normal firmware operation.
    endmenu

endmenu
```

## sdkconfig.defaults
```kconfig
# Aqua-HMET sdkconfig.defaults — committed; drives idf.py configuration defaults.
# The generated `sdkconfig` is git-ignored (never commit sdkconfig itself).
# To regenerate: idf.py reconfigure

# ---- Flash ----
# Use the choice bool, NOT the derived string CONFIG_ESPTOOLPY_FLASHSIZE="4MB".
# In ESP-IDF Kconfig, setting the choice item (FLASHSIZE_4MB=y) is what drives
# the flash-size selection; the string is auto-derived from whichever choice is set.
CONFIG_ESPTOOLPY_FLASHSIZE_4MB=y

# ---- Partition table ----
CONFIG_PARTITION_TABLE_CUSTOM=y
CONFIG_PARTITION_TABLE_CUSTOM_FILENAME="partitions.csv"

# ---- FreeRTOS: dual-core (unicore = OFF for SMP, Core0=WiFi/UI, Core1=acquisition) ----
CONFIG_FREERTOS_UNICORE=n

# ---- FreeRTOS tick rate: 1000 Hz = 1 ms resolution ----
# Default is 100 Hz (10 ms/tick), which makes pdMS_TO_TICKS(2) = 0 (a no-op taskYIELD).
# ADS1115 averaging needs real 2 ms inter-sample gaps (1.7 conversion periods @860 SPS)
# to read independent samples. Without this, pstat_adc_read_current_uA averages
# identical values and gets zero noise reduction.
# 1000 Hz is standard practice for timing-sensitive ESP32 applications.
CONFIG_FREERTOS_HZ=1000

# ---- HTTP server: WebSocket support required for P5 ----
CONFIG_HTTPD_WS_SUPPORT=y

# ---- Default log level: WARN (overridden at runtime in P7 via esp_log_level_set) ----
CONFIG_LOG_DEFAULT_LEVEL_WARN=y

# ---- Main task stack (bytes) — bumped from default 3584 ----
CONFIG_ESP_MAIN_TASK_STACK_SIZE=16384

# ---- LVGL9 configuration (P4) ----
# Use FreeRTOS for LVGL thread safety (mutex + task notification).
# LVGL task will be pinned to Core 0 in ui_tft_start() to avoid Core 1 (acquisition).
CONFIG_LV_OS_FREERTOS=y

# Montserrat fonts: 14pt (hint bar / small UI), 20pt (labels/values), 28pt (big peak display).
CONFIG_LV_FONT_MONTSERRAT_14=y
CONFIG_LV_FONT_MONTSERRAT_20=y
CONFIG_LV_FONT_MONTSERRAT_28=y
# Default LVGL font = Montserrat 14.
CONFIG_LV_FONT_DEFAULT_MONTSERRAT_14=y

# LVGL memory: use ESP-IDF heap (CLIB) instead of LVGL's builtin 64 KB TLSF pool.
# 5 screens + line chart + 3 Montserrat fonts exceed 64 KB; the full heap has ~180 KB free.
CONFIG_LV_USE_CLIB_MALLOC=y
CONFIG_LV_USE_CLIB_STRING=y
CONFIG_LV_USE_CLIB_SPRINTF=y

# Color depth: 16-bit RGB565 to match ILI9341 panel.
# This is the Kconfig default but stated explicitly for clarity.
CONFIG_LV_COLOR_DEPTH_16=y

# ---- WiFi memory reduction (P5+) ----
# Default static RX buffer count is 10 (16 KB). Reduced to 4 to free ~10 KB of
# contiguous DRAM for LVGL. SoftAP-only, low-throughput use: 4 buffers is sufficient.
CONFIG_ESP_WIFI_STATIC_RX_BUFFER_NUM=4
# Dynamic RX/TX: reduce from 32 to 16 — halves peak dynamic buffer pool.
CONFIG_ESP_WIFI_DYNAMIC_RX_BUFFER_NUM=16
CONFIG_ESP_WIFI_DYNAMIC_TX_BUFFER_NUM=16
# Disable AMPDU aggregation — throughput optimisation not needed for potentiostat SoftAP.
# Saves additional internal driver state (~4 KB).
CONFIG_ESP_WIFI_AMPDU_TX_ENABLED=n
CONFIG_ESP_WIFI_AMPDU_RX_ENABLED=n

# ---- LwIP socket pool ----
# Default LWIP_MAX_SOCKETS=10. httpd needs max_open_sockets(9) + 3 internal = 12 > 10 → fail.
# Raise to 16 to give headroom for WiFi DHCP/DNS + httpd + WebSocket clients.
CONFIG_LWIP_MAX_SOCKETS=16

# ---- LwIP: disable IPv6 ----
# All SoftAP services (HTTP, WebSocket, mDNS, DHCP, captive DNS) are IPv4-only.
# IPv6 allocates ND6 neighbor/prefix/router/destination tables + 3 addresses per
# interface at init time (~15-20 KB heap). Disabling it reclaims that heap for LVGL.
CONFIG_LWIP_IPV6=n

# ---- Task WDT ----
# IDLE0 monitoring disabled: the LVGL task legitimately saturates Core 0
# during DPV scans (320-point line chart SPI rendering). IDLE0 can't
# run enough to feed the WDT. The WDT itself stays enabled — it still
# catches deadlocks on Core 1 (IDLE1) and any explicitly-subscribed tasks.
CONFIG_ESP_TASK_WDT_TIMEOUT_S=10
CONFIG_ESP_TASK_WDT_CHECK_IDLE_TASK_CPU0=n
```
